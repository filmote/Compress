#include <Arduboy2.h>

Arduboy2 arduboy;

const uint8_t PROGMEM threeColour_01[] {  // 6
0x20, 0x86, 0x9C, 0xA4, 0xE4, 0x88, 
};

const uint8_t PROGMEM ardbitmap_01[] ={ //  8
0x87, 0x0f, 0x05, 0xf8, 0x30, 0xf0, 0x69, 0x00,
};

const uint8_t PROGMEM drawCompressed_01[] = { // 8
0x07, 0x0f, 0x5d, 0x15, 0xe2, 0x2a, 0xd4, 0x05
};

const uint8_t PROGMEM threeColour_02[] { // 346
0x82, 0xB4, 0x4D, 0x49, 0x11, 0x23, 0x49, 0xB5, 0x44, 0xD4, 0x89, 0x26, 0xC4, 0x89, 0x43, 0x48, 
0x54, 0x47, 0x49, 0xB5, 0x42, 0x54, 0x96, 0x24, 0x89, 0x26, 0xF5, 0x11, 0x15, 0x22, 0x22, 0x4D, 
0x8B, 0x0A, 0xE4, 0xB1, 0x24, 0x49, 0x24, 0x31, 0x4B, 0xC9, 0x25, 0x28, 0x8E, 0x90, 0xAE, 0x46, 
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0xCD, 0x23, 0x31, 0x4C, 0xCA, 0x26, 0xB1, 0x8D, 0xAC, 0xD3, 0x70, 
};

const uint8_t PROGMEM ardbitmap_02[] = { // 178
0x2b, 0x3f, 0x37, 0x07, 0x5a, 0xb7, 0x09, 0xc8, 0xc2, 0x61, 0x04, 0x10, 0x91, 0x02, 0x8a, 0x01, 
0xb0, 0xb2, 0x03, 0xcb, 0x3a, 0xd0, 0xfa, 0x47, 0x19, 0xb2, 0x10, 0x08, 0x26, 0xee, 0x0c, 0x8e, 
0x20, 0x01, 0x6c, 0x08, 0xe0, 0xb0, 0xa4, 0x10, 0x07, 0x08, 0x71, 0x14, 0x26, 0x5b, 0x02, 0xd8, 
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0xbf, 0x0b,
};

const uint8_t PROGMEM drawCompressed_02[] = { // 192
0x2a, 0x3f, 0xb8, 0x96, 0xbd, 0xdb, 0xaf, 0x54, 0x9d, 0x6d, 0xb9, 0xba, 0xea, 0xee, 0x5c, 0xf5, 
0xad, 0xaa, 0x76, 0xe7, 0x55, 0xd9, 0xdd, 0xb2, 0x77, 0x43, 0x46, 0xf2, 0x6c, 0x57, 0xaa, 0x95, 
0xda, 0x2b, 0x19, 0x59, 0x9d, 0xaa, 0x76, 0x2a, 0x55, 0x2d, 0x77, 0x29, 0x57, 0x6a, 0x59, 0x97, 
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0x65, 0xd7, 0xd9, 0x4a, 0x27, 0x2b, 0x9b, 0x0d, 0x5a, 0xb4, 0x7e, 0xf8, 0xd4, 0x79, 0x87, 0x57
};

const uint8_t PROGMEM threeColour_03[] { // 514
0x84, 0x04, 0x73, 0x64, 0x18, 0x14, 0x4D, 0x64, 0x99, 0xD2, 0x24, 0x8D, 0x92, 0x6F, 0x49, 0x11, 
0x67, 0x74, 0x91, 0x92, 0x77, 0x49, 0x21, 0x27, 0x54, 0x92, 0x92, 0x73, 0x49, 0x31, 0x27, 0x14, 
0x93, 0x92, 0x6F, 0x49, 0x41, 0x26, 0x96, 0x29, 0x49, 0x26, 0x55, 0x96, 0x12, 0x61, 0x59, 0x6D, 
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0x42, 0xA3, 0x6A, 0x49, 0xCC, 0x43, 0xE3, 0x10, 0xFA, 0x93, 0xF4, 0x8F, 0xE1, 
};

const uint8_t PROGMEM ardbitmap_03[] = { // 283
0x3f, 0x3f, 0x3f, 0x97, 0xe1, 0x60, 0xb1, 0x58, 0x4c, 0x16, 0x93, 0x89, 0x00, 0x06, 0x90, 0x00, 
0x12, 0x4a, 0xa8, 0xd3, 0xe9, 0xbf, 0x32, 0x13, 0xf3, 0xbd, 0xac, 0xb6, 0x11, 0x04, 0x01, 0x52, 
0x70, 0x98, 0xb0, 0x00, 0x80, 0x02, 0x38, 0xa0, 0x6b, 0xac, 0xfc, 0x33, 0x61, 0xb1, 0x58, 0x2c, 
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0x01, 0x5c, 0x2e, 0x97, 0x4c, 0x0a, 0xb6, 0xed, 0x60, 0x01, 0x07,
};

const uint8_t PROGMEM drawCompressed_03[] = { //306
0x3f, 0x3f, 0xd0, 0x9d, 0x5c, 0x66, 0xb3, 0xd9, 0x74, 0x36, 0x9d, 0xee, 0xaa, 0x55, 0x75, 0xaa, 
0x3a, 0x95, 0x4b, 0xe5, 0xd6, 0xeb, 0x61, 0xd9, 0x95, 0x5a, 0xe1, 0x4b, 0x59, 0xe7, 0x9c, 0xba, 
0xae, 0xab, 0x94, 0xab, 0xe5, 0x4a, 0x65, 0xab, 0x2a, 0x57, 0xb5, 0x2c, 0x67, 0xa5, 0x55, 0xd0, 
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0x11, 0x01
};


// Helper for drawCompressed()
struct BitStreamReader {

  const uint8_t *source;
  uint16_t sourceIndex;
  uint8_t bitBuffer;
  uint8_t byteBuffer;

  BitStreamReader(const uint8_t *source) : source(source), sourceIndex(), bitBuffer(), byteBuffer() { }

  uint16_t readBits(uint16_t bitCount) {

    uint16_t result = 0;

    for (uint16_t i = 0; i < bitCount; i++) {

      if (this->bitBuffer == 0) {
        this->bitBuffer = 0x80;
        this->byteBuffer = pgm_read_byte(&this->source[this->sourceIndex]);
        ++this->sourceIndex;
      }

      if ((this->byteBuffer & this->bitBuffer) != 0) {
        result |= (1 << ((bitCount - 1) - i)); // result |= bitshift_left[i];

      }

      this->bitBuffer >>= 1;

    }

    return result;

  }

};

void draw3ColourCompressed(int16_t sx, int16_t sy, const uint8_t *bitmap, uint8_t color) {

	// set up decompress state
	BitStreamReader cs = BitStreamReader(bitmap);

	// read header
	uint8_t height = (int)cs.readBits(4) * 8;
	uint8_t width = (int)cs.readBits(8);
	uint8_t shortRun = (int)cs.readBits(3);
	uint8_t longRun = 3 * shortRun;

  uint8_t x = 0;
  uint8_t y = 0;

	// no need to draw at all if we're offscreen
	if ((sx + width < 0) || (sx > WIDTH - 1) || (sy + height < 0) || (sy > HEIGHT - 1))
		return;
	
	while (1) {

		uint8_t spanColour = (uint8_t)cs.readBits(2);
		uint8_t isShortRun = ((uint8_t)cs.readBits(1) == 0);
		uint16_t run = 0;
		
		if (isShortRun) {
			run = (uint8_t)cs.readBits(shortRun);
		}
		else {
			run = (uint8_t)cs.readBits(longRun);
		}
		
		for (uint8_t i = 0; i < run; i++) {
			
			switch (spanColour) {
			
				case BLACK:
				case WHITE:
					arduboy.drawPixel(sx + x, sy + y, spanColour);
					y++;  if (y == height) { y = 0; x++; }
					break;
					
				default:
					arduboy.drawPixel(sx + x, sy + y, WHITE);
					y++;  if (y == height) { y = 0; x++; }

					arduboy.drawPixel(sx + x, sy + y, BLACK);
					y++;  if (y == height) { y = 0; x++; }
					
			}
			
		}

		if (x >= width) break;
		
	}
}



/* -----------------------------------------------------------------------------------------------------------------------------
 *  Setup ..
 * -----------------------------------------------------------------------------------------------------------------------------
 */
void setup() {

  arduboy.boot();
  arduboy.display();
  arduboy.flashlight();
  arduboy.systemButtons();
  arduboy.clear();
  arduboy.setFrameRate(60);

}


/* -----------------------------------------------------------------------------------------------------------------------------
 *  Main loop ..
 * -----------------------------------------------------------------------------------------------------------------------------
 */
void loop() {

  if (!(arduboy.nextFrame())) return;
  arduboy.clear();

  //if (arduboy.pressed(A_BUTTON))
  draw3ColourCompressed(10, 10, threeColour_03, WHITE);

  arduboy.display();

}